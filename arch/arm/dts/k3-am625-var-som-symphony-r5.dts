// SPDX-License-Identifier: GPL-2.0
/*
 * VAR-SOM-AM62 dts file for R5 SPL
 * Copyright (C) 2021-2022 Texas Instruments Incorporated - https://www.ti.com/
 * Copyright (C) 2022 Variscite Ltd. - https://www.variscite.com/
 */

#include "k3-am625-var-som-symphony.dts"
#include "k3-am62x-var-som-ddr4-1600MTs.dtsi"
#include "k3-am62-ddr.dtsi"

#include "k3-am625-var-som-u-boot.dtsi"
#include "k3-am62x-r5-var-som-common.dtsi"
